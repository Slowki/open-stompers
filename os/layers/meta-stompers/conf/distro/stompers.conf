## os/layers/meta-stompers/conf/layer.conf
```bitbake
BBPATH .= ":${LAYERDIR}"

BBFILES += " \
    ${LAYERDIR}/recipes-*/*/*.bb \
    ${LAYERDIR}/recipes-*/*/*.bbappend \
"

# Platform-specific recipes, enabled only when the BSP layer is present.
BBFILES_DYNAMIC += " \
    tegra:${LAYERDIR}/dynamic-layers/tegra/recipes-*/*/*.bb \
    tegra:${LAYERDIR}/dynamic-layers/tegra/recipes-*/*/*.bbappend \
    rockchip:${LAYERDIR}/dynamic-layers/rockchip/recipes-*/*/*.bb \
    rockchip:${LAYERDIR}/dynamic-layers/rockchip/recipes-*/*/*.bbappend \
"

# Shared kernel configuration fragments.
STOMPERS_KERNEL_FRAGMENTS_DIR := "${LAYERDIR}/files/kernel"

BBFILE_COLLECTIONS += "stompers"
BBFILE_PATTERN_stompers = "^${LAYERDIR}/"
BBFILE_PRIORITY_stompers = "10"

LAYERVERSION_stompers = "1"
LAYERDEPENDS_stompers = "core yocto openembedded-layer networking-layer swupdate"
LAYERSERIES_COMPAT_stompers = "wrynose"
```
